## generated/C35SPMX-akdk/boards/shields/c35mxsp/Kconfig.defconfig
```kconfig
if SHIELD_C35SPMX_LEFT
config ZMK_KEYBOARD_NAME
    default "C35SPMX"
config ZMK_SPLIT_ROLE_CENTRAL
    default y
endif

if SHIELD_C35SPMX_LEFT || SHIELD_C35SPMX_RIGHT
config ZMK_SPLIT
    default y
endif
```

## generated/C35SPMX-akdk/boards/shields/c35mxsp/Kconfig.shield
```kconfig
config SHIELD_C35SPMX_LEFT
    def_bool $(shields_list_contains,C35SPMX_left)
config SHIELD_C35SPMX_RIGHT
    def_bool $(shields_list_contains,C35SPMX_right)
```

## generated/C35SPV2-akdk/boards/shields/c35v2sp/Kconfig.defconfig
```kconfig
if SHIELD_C35SPV2_LEFT
config ZMK_KEYBOARD_NAME
    default "C35SPV2"
config ZMK_SPLIT_ROLE_CENTRAL
    default y
endif

if SHIELD_C35SPV2_LEFT || SHIELD_C35SPV2_RIGHT
config ZMK_SPLIT
    default y
endif
```

## generated/C35SPV2-akdk/boards/shields/c35v2sp/Kconfig.shield
```kconfig
config SHIELD_C35SPV2_LEFT
    def_bool $(shields_list_contains,C35SPV2_left)
config SHIELD_C35SPV2_RIGHT
    def_bool $(shields_list_contains,C35SPV2_right)
```
